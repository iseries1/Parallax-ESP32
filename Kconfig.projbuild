## Kconfig.projbuild
```kconfig
menu "Parallax ESP32 Configuration"

    config VERSION
        string "Version Number"
        default "5.0"

    choice LOGGING
        prompt "Logging On"
        default NO_LOGGING
        config NO_LOGGING
            bool "NO_LOGGING"
        config LOGGING
            bool "LOGGING"
    endchoice
    
    choice ESP_LED_TYPE
        prompt "LED TYPE selection"
        default NO_LED
        help
            Type of LED on the board none, strip, led.
        config NO_LED
            bool "NOLED"
        config LED
            bool "LED"
        config STRIP
            bool "STRIP"
        config RGB
            bool "RGB"
    endchoice

endmenu
```
